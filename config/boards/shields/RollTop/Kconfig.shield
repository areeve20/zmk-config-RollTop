## config/boards/shields/RollTop/Kconfig.shield
```kconfig
# Copyright (c) 2023 The ZMK Contributors
# SPDX-License-Identifier: MIT

config SHIELD_ROLLTOP
    def_bool $(shields_list_contains,rolltop)
```
